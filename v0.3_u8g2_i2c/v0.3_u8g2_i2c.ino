//Source pour la corélation entre accélérometre et gyroscope

//Utilise seul acc pour trouver inclinaison mais probleme lors d'un mouvement
//https://www.youtube.com/watch?v=USa3HFLnrlk&t
//https://www.instructables.com/DIY-Digital-Spirit-Level/

//Démontre comment utiliser
//https://www.youtube.com/watch?v=XCyRXMvVSCw&t
//https://dronebotworkshop.com/mpu-6050-level/

//Démontre comment utiliser
//https://www.youtube.com/watch?v=UxABxSADZ6U.

//Théorique du pourquoi il utilise l'acc et le gyro ensemble !
//https://www.posital.com/fr/produits/inclinometres/mems/MEMS-Technology.php



#include <Arduino_LSM9DS1.h>
#include <Arduino.h>
#include <U8g2lib.h>

#ifdef U8X8_HAVE_HW_SPI
#include <SPI.h>
#endif
#ifdef U8X8_HAVE_HW_I2C
#include <Wire.h>
#endif
U8G2_SH1106_128X64_NONAME_1_HW_I2C u8g2(U8G2_R0, /* reset=*/ U8X8_PIN_NONE);


float accelX,            accelY,             accelZ,            // units m/s/s i.e. accelZ if often 9.8 (gravity)
      gyroX,             gyroY,              gyroZ,             // units dps (degrees per second)
      gyroDriftX,        gyroDriftY,         gyroDriftZ,        // units dps
      gyroRoll,          gyroPitch,          gyroYaw,           // units degrees (expect major drift)
      gyroCorrectedRoll, gyroCorrectedPitch, gyroCorrectedYaw,  // units degrees (expect minor drift)
      accRoll,           accPitch,           accYaw,            // units degrees (roll and pitch noisy, yaw not possible)
      complementaryRoll, complementaryPitch, complementaryYaw;  // units degrees (excellent roll, pitch, yaw minor drift)

long lastTime;
long lastInterval;

int directions, angles, temps(0), acceleration, acc;

unsigned long temperature_timer = millis();
//float angles_offset;

static unsigned char bmpdata[] PROGMEM = {
0x00, 0x00, 0x00, 0x00, 0x00, 0x00, 0x00, 0x00, 0x00, 0x00, 0x00, 0x00, 0x00, 0x00, 0x00, 0x00, 0x00, 0x00, 0x00, 0x00, 0x00, 0x00, 0x00, 0x00, 0x00, 0x00, 0x00, 0x00, 0x00, 0x00, 0x00, 0x00, 
0x00, 0x00, 0x00, 0x00, 0x00, 0x00, 0x00, 0x00, 0x00, 0x00, 0x00, 0x00, 0x00, 0x00, 0x00, 0x00, 0x00, 0x00, 0x00, 0x00, 0x00, 0x00, 0x00, 0x00, 0x00, 0x00, 0x00, 0x00, 0x00, 0x00, 0x00, 0x00, 
0x00, 0x00, 0x00, 0x00, 0x00, 0x00, 0x00, 0x00, 0x00, 0x00, 0x00, 0x00, 0x00, 0x00, 0x00, 0x00, 0x00, 0x00, 0x00, 0x00, 0x00, 0x00, 0x00, 0x00, 0x00, 0x00, 0x00, 0x00, 0x00, 0x00, 0x00, 0x00, 
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0x00, 0x00, 0x00, 0x00, 0x00, 0x00, 0x00, 0x00, 0x00, 0x00, 0x00, 0x00, 0x00, 0x00, 0x00, 0x00, 0x00, 0x00, 0x00, 0x00, 0x00, 0x00, 0x00, 0x00, 0x00, 0x00, 0x00, 0x00, 0x00, 0x00, 0x00, 0x00, 
};



void setup() {
  u8g2.begin();
  //u8g2.clearBuffer();          // clear the internal memory
  u8g2.firstPage();
   do {
        u8g2.drawXBMP( 0, 0, 128, 64, bmpdata);
  } while( u8g2.nextPage() );
  if (!IMU.begin()) {
    //Serial.println("Failed to initialize IMU!");
    while (1);
  }
  calibrateIMU(250, 250);
  lastTime = micros();
  delay(2000);
}

//----------------------------------------------CALIBLRATION
void calibrateIMU(int delayMillis, int calibrationMillis) { 
  int calibrationCount = 0;
  delay(delayMillis); // to avoid shakes after pressing reset button
  float sumX, sumY, sumZ;
  int startTime = millis();
  while (millis() < startTime + calibrationMillis) {
    if (readIMU()) {
      // in an ideal world gyroX/Y/Z == 0, anything higher or lower represents drift
      sumX += gyroX;
      sumY += gyroY;
      sumZ += gyroZ;

      calibrationCount++;
    }
  }
  if (calibrationCount == 0) {
    //Serial.println("Failed to calibrate");
  }
  gyroDriftX = sumX / calibrationCount;
  gyroDriftY = sumY / calibrationCount;
  gyroDriftZ = sumZ / calibrationCount;
}

//----------------------------------------------LIRE INFO
bool readIMU() {
  if (IMU.accelerationAvailable() && IMU.gyroscopeAvailable() ) {
    IMU.readAcceleration(accelX, accelY, accelZ);
    IMU.readGyroscope(gyroX, gyroY, gyroZ); 
//    if(millis() < 2500){
//      accPitch = atan2(-accelX, sqrt(accelY * accelY + accelZ * accelZ)) * 180 / M_PI;
//      angles_offset = accPitch;  
//    }
    return true;
  }
  return false;
}
//----------------------------------------------MAIN
void loop() {

  angles = complementaryPitch; 
  acceleration = complementaryRoll;
  u8g2.firstPage();
  do {
    //----------------------------------------------UPDATE DES INFOS ET CALCULER L'ANGLE ACTUEL
    if (readIMU()) {
      long currentTime = micros();
      lastInterval = currentTime - lastTime; // expecting this to be ~104Hz +- 4%
      lastTime = currentTime;
      doCalculations();       
    }    
    //----------------------------------------------DIRECTIONS
    if(complementaryPitch > 0){
      directions = 1;//gauche
    }
    else if (complementaryPitch < 0){
      directions = 0;//droite
    }   
    //----------------------------------------------CONVERTION ANGLES    
    angles = sqrt(pow(angles, 2)); // Toujours positif
    //----------------------------------------------FLÈCHE
    if(directions == 0 && int(angles) > 2){//Fleche a gauche
      u8g2.drawTriangle(24,30, 42,18, 42,38);//triangle
    }
    else if(directions == 1 && int(angles) > 2){//Fleche a droite
      u8g2.drawTriangle(116,30, 98,18, 98,38);//triangle
    }    
    //----------------------------------------------AFFICHAGE ANGLE
    u8g2.setFont(u8g2_font_helvB24_tn);
    u8g2.setCursor(47,40);
    if(int(angles) < 10){ //afficher un 0 avant le chiffre 
        u8g2.print("0");   //si le chiffre est en 0 et 9
    }
    u8g2.print(int(angles));
    u8g2.setFont(u8g2_font_helvB24_tf);
    u8g2.write(0xB0);//afficher le signe degree
    //----------------------------------------------TEMPERATURE                                     
    u8g2.setFont(u8g2_font_5x7_tf); //police
    u8g2.setCursor(0, 7);
    if(millis()>temperature_timer+5000){  //timer pour que la temperature se refresh a chaque seconde
      temps = IMU.readTemp(); //Lecture temperature du mpu
      temperature_timer = millis();
    }
    u8g2.print(temps);
    u8g2.write(0xB0);//afficher le signe degree  
    u8g2.print("C");         
    //----------------------------------------------GAUGE_INCLINAISON
    u8g2.drawBox(64,50, 4,14);//ligne au millieu
    if(directions == 0 && angles>2){ //bar si penche a gauche
      if(angles < 48){
        u8g2.drawBox((62-angles),52, angles,10);
      }
      else{                  
        u8g2.drawBox (12,52, 50,10);
      }
    }
    else if(directions == 1 && angles>2 ){//bar si penche a droite
      if(angles < 47){
        u8g2.drawBox(70,52,angles,10);
      }
      else{
        u8g2.drawBox(70,52, 46,10);
      }
    } 
    //-----------------------------------------------ACCELERATION                
    if(complementaryRoll < 0){//acceleration
      acc = 0;
    }
    else if(complementaryRoll >= 0){//deceleration
      acc = 1;  
    }
    acceleration = sqrt(pow(acceleration, 2));  
    //-----------------------------------------------LIGNE ACCELERATION              
    u8g2.drawBox(118,60, 10,4);
    if(acceleration > 1 && acc == 1){                
      u8g2.drawBox(121,(62-acceleration), 4,acceleration);
    }
    //-----------------------------------------------LIGNE DECELERATION  
    u8g2.drawBox(0,60, 10,4);
    if(acceleration > 1 && acc == 0){                
      u8g2.drawBox(3,(62-acceleration), 4,acceleration);
    }
    
    //-----------------------------------------------    
  } while ( u8g2.nextPage() );
  
}

//----------------------------------------------CALCULER L'ANGLE 
bool flag = 0;
void doCalculations() {
  accRoll = atan2(accelY, accelZ) * 180 / M_PI;
  accPitch = atan2(-accelX, sqrt(accelY * accelY + accelZ * accelZ)) * 180 / M_PI;
  //gyroPitch = gyroPitch - angles_offset;
  float lastFrequency = (float) 1000000.0 / lastInterval;
  gyroRoll = gyroRoll + (gyroX / lastFrequency);
  gyroPitch = gyroPitch + (gyroY / lastFrequency);
  gyroYaw = gyroYaw + (gyroZ / lastFrequency);

  gyroCorrectedRoll = gyroCorrectedRoll + ((gyroX - gyroDriftX) / lastFrequency);
  gyroCorrectedPitch = gyroCorrectedPitch + ((gyroY - gyroDriftY) / lastFrequency);
  gyroCorrectedYaw = gyroCorrectedYaw + ((gyroZ - gyroDriftZ) / lastFrequency);

  complementaryRoll = complementaryRoll + ((gyroX - gyroDriftX) / lastFrequency);
  complementaryPitch = complementaryPitch + ((gyroY - gyroDriftY) / lastFrequency);
  complementaryYaw = complementaryYaw + ((gyroZ - gyroDriftZ) / lastFrequency);
  
  //gyroCorrectedPitch = gyroCorrectedPitch - angles_offset;
  
  complementaryRoll = 0.95 * complementaryRoll + 0.05 * accRoll;
  complementaryPitch = 0.95 * complementaryPitch + 0.05 * accPitch;
}
